## code/ESP32/main/Kconfig.projbuild
```kconfig
menu "SIM7600 Modem Configuration"

    menu "UART Configuration"
        config GATEWAY_MODEM_UART_NUM
            int "UART peripheral for modem communication"
            range 1 2
            default 1
            help
                Select UART_NUM_x for modem interface

        config GATEWAY_MODEM_UART_EVENT_TASK_STACK_SIZE
            int "UART Event Task Stack Size"
            range 2000 6000
            default 4096
            help
                Stack size of UART event task.

        config GATEWAY_MODEM_UART_EVENT_TASK_PRIORITY
            int "UART Event Task Priority"
            range 3 22
            default 5
            help
                Priority of UART event task.

        config GATEWAY_MODEM_UART_EVENT_QUEUE_SIZE
            int "UART Event Queue Size"
            range 10 40
            default 30
            help
                Length of UART event queue.

        config GATEWAY_MODEM_UART_PATTERN_QUEUE_SIZE
            int "UART Pattern Queue Size"
            range 10 40
            default 20
            help
                Length of UART pattern queue.

        config GATEWAY_MODEM_UART_TX_BUFFER_SIZE
            int "UART TX Buffer Size"
            range 256 16384
            default 4096
            help
                Buffer size of UART TX buffer. Recommended 2048 for NAT applications.

        config GATEWAY_MODEM_UART_RX_BUFFER_SIZE
            int "UART RX Buffer Size"
            range 256 16384
            default 8192
            help
                Buffer size of UART RX buffer. Recommended 16384 for NAT applications.

        config GATEWAY_MODEM_DTE_BUFFER_SIZE
            int "UART DTE Buffer Size"
            range 256 4096
            default 512
            help
                DTE buffer size.

    endmenu
endmenu
```
